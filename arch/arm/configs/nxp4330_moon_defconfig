## arch/arm/mach-nxp4330/Kconfig
```kconfig
#
# Copyright 2009 Nexell.
#

config ARCH_CPU_NEXELL
	bool
	depends on ARCH_NXP4330
	default y
	
if ARCH_CPU_NEXELL

choice
	prompt "Prototype build mode"
	default PROTOTYPE_RELEASE

config  PROTOTYPE_RELEASE
	bool "Release"

config  PROTOTYPE_DEBUG
	bool "Debug"
endchoice

choice
	prompt "Memory max order"
	default MEM_MAX_ORDER_11

config	MEM_MAX_ORDER_11
	bool "4Mbyte"

config	MEM_MAX_ORDER_12
    bool "8Mbyte"

config	MEM_MAX_ORDER_13
	bool "16Mbyte"

endchoice

config FORCE_MAX_ZONEORDER
   	int
   	default 11 if MEM_MAX_ORDER_11
   	default 12 if MEM_MAX_ORDER_12
   	default 13 if MEM_MAX_ORDER_13

comment "CPU features"

config SUSPEND_IDLE
	bool "Goto idle when Suspend"
	depends on SUSPEND
	default n

config PM_DBGOUT
	bool "Support PM_DBGOUT"
	default n

config HAVE_PWM
	prompt "PWM driver"
	bool
	select NEXELL_SOC_PWM
	default y

config PWM_SYSFS
	bool "/sys/devices/platform/pwm.N (sysfs interface)"
	depends on HAVE_PWM
	default y

config HAVE_PWM_CH0
	bool "pwm 0"
	depends on HAVE_PWM
	default y

config HAVE_PWM_CH1
	bool "pwm 1"
	depends on HAVE_PWM
	default n

config HAVE_PWM_CH2
	bool "pwm 2"
	depends on HAVE_PWM
	default n

config HAVE_PWM_CH3
	bool "pwm 3"
	depends on HAVE_PWM
	default n

config NEXELL_SOC_PWM
	bool "Support PWM SoC"
	default y if HAVE_PWM

config NEXELL_DISPLAY
	bool "Support Display SoC"
	default n

config NEXELL_DISPLAY_1ST
	bool "Primary   display output (MLC0/DPC0)"
	depends on NEXELL_DISPLAY

config NEXELL_DISPLAY_2ST
	bool "Secondary display output (MLC1/DPC1)"
	depends on NEXELL_DISPLAY

config NEXELL_DISPLAY_RESCONV
	bool "Resolution Converter"
	depends on NEXELL_DISPLAY
	default n

config ADC_NEXELL
	tristate "Nexell ADC"
	depends on ARCH_NXP4330
	default y
	---help---
	This option enables the Nexell ADC driver.  

config SOC_LFP100
	tristate "Support for the LFP100/LFP200/LFP300/LFP400 audio/power/backlight chip"
	default y
	---help---
	This option enables platform support for the LFP100 combination
	chip.  It is checked at runtime.  If you are unsure, say Y.
	This option is only for all LeapFrog boards. 

config BQ24250_CHARGER
	bool "BQ24250 Charger"
	default y
	---help---
	This option enables BQ24250 charger chip driver. This driver is only required for Cabo.

config TC7734_PMIC
	bool "TC7734 PMIC"
	default n
	---help---
	This option enables the TC7734 PMIC driver.

choice
        prompt "System Power Down Mode"
        default POWER_DOWN_STANDBY
	---help---
	This option chooses whether the system completely powers off or goes into standby mode.

config  POWER_DOWN_OFF
        bool "Off"
	---help---
	Place system in OFF mode

config  POWER_DOWN_STANDBY
        bool "Standby"
	---help---
	Place system in STANDBY mode

endchoice

config NEXELL_DFS_BCLK
    bool "DFS For BCLK"
    default n

choice
    prompt "Select BCLK PLL device"
    depends on NEXELL_DFS_BCLK
    default NXP4330_DFS_BCLK_PLL_0

config NXP4330_DFS_BCLK_PLL_0
    bool "PLL 0"

config NXP4330_DFS_BCLK_PLL_1
    bool "PLL 1"

endchoice

config ANDROID_PERSISTENT_RAM_CONS_AREA
    hex "RAM console physical hex address"
    depends on ANDROID_RAM_CONSOLE
    default 0x0

config ANDROID_PERSISTENT_RAM_CONS_SIZE
    int "RAM console size (KB)"
    depends on ANDROID_RAM_CONSOLE
    default 16

source "kernel/Kconfig.hz"

endif
```

## arch/arm/plat-nxp4330/Kconfig
```kconfig
#
# Copyright 2009 Nexell.
#
# Configuration options for the NXP4330

config PLAT_NXP4330
	bool
	depends on ARCH_NXP4330
	default y

#
# Select Board
#

comment "Board features"

choice
	prompt "Platform board"
	default NXP4330_LEAPFROG

	config PLAT_NXP4330_BLACKBOX
		bool "BLACKBOX: blackbox board"
		help
			Support for the blackbox board.

	config PLAT_NXP4330_DRONE
		bool "DRONE: Android drone board"
		help
			Support for the drone board.

	config PLAT_NXP4330_KAR
		bool "KAR: Android Car Navigation board"
		help
			Support for the kar board.

	config PLAT_NXP4330_LYNX
		bool "LYNX: Android MID board"
		help
			Support for the android MID (Lynx) board.

	config PLAT_NXP4330_MOON
		bool "MOON: Linux CCTV board"
		help
			Support for the moon board.

	config PLAT_NXP4330_MORPHEUS
		bool "MORPHEUS: Android morpheus board"
		help
			Support for the android morpheus board.

	config PLAT_NXP4330_NBOX
		bool "NBOX: Android NBOX board"
		help
			Support for the android nbox board.

	config PLAT_NXP4330_PYXIS
		bool "PYXIS: Android Pyxis board"
		help
			Support for the android pysix tablet board.
	
	config PLAT_NXP4330_SECRET
		bool "SECRET: Android secret board"
		help
			Support for the android secret board.

	config PLAT_NXP4330_SMARTBOX
		bool "SMARTBOX: Android Smart Box"
		help
			Support for the android smart box board.

	config PLAT_NXP4330_VTK
		bool "VTK: Validation Kit board"
		help
			Support for the validation kit board.

	config PLAT_NXP4330_W7
		bool "W7: Android w7 board"
		help
			Support for the android w7 tablet board.

	config NXP4330_LEAPFROG
		bool "LEAPFROG: LeapFrog boards"
		help
			Support for LeapFrog boards

if (NXP4330_LEAPFROG)
choice
	prompt "LeapFrog Boards"
	default PLAT_NXP4330_BOGOTA

	config PLAT_NXP4330_BOGOTA
		bool "BOGOTA: Leapfrog Bogota tablet"
		depends on NXP4330_LEAPFROG
		help
			Support for LeapFrog Bogota tablet

	config PLAT_NXP4330_XANADU
		bool "XANADU: Leapfrog Xanadu tablet"
		depends on NXP4330_LEAPFROG
		help
			Support for LeapFrog Xanadu tablet

	config PLAT_NXP4330_GLASGOW
		bool "GLASGOW: Leapfrog Glasgow console"
		depends on NXP4330_LEAPFROG
		help
			Support for LeapFrog Glasgow console
	
	config PLAT_NXP4330_CABO
		bool "CABO: Leapfrog Cabo tablet"
		depends on NXP4330_LEAPFROG
		help
			Support for LeapFrog Cabo tablet
	
	config PLAT_NXP4330_QUITO
		bool "QUITO: Leapfrog Quito tablet"
		depends on NXP4330_LEAPFROG
		help
			Support for LeapFrog Quito tablet
endchoice
endif

endchoice

#
# Board dependent configure
#

if PLAT_NXP4330_LYNX
source "arch/arm/plat-nxp4330/lynx/Kconfig"
endif

if PLAT_NXP4330_SECRET
source "arch/arm/plat-nxp4330/secret/Kconfig"
endif
```

## arch/arm/plat-nxp4330/secret/Kconfig
```kconfig
#
# Copyright 2009 Nexell.
#
# Configuration options for the NXP4330

#
# Select Board
#

comment "SECRET Board features"

config BROADCOM_WIFI_USE_OOB
    bool "Use broadcom external gpio irq instead of sdio irq"
    default n

choice
    prompt "Select OOB IRQ Alive GPIO"
    depends on BROADCOM_WIFI_USE_OOB
    default OOB_INTR_ALIVE_0

config OOB_INTR_ALIVE_0
    bool "ALIVE0"

config OOB_INTR_ALIVE_1
    bool "ALIVE1"

config OOB_INTR_ALIVE_2
    bool "ALIVE2"

config OOB_INTR_ALIVE_3
    bool "ALIVE3"

config OOB_INTR_ALIVE_4
    bool "ALIVE4"

config OOB_INTR_ALIVE_5
    bool "ALIVE5"

config OOB_INTR_ALIVE_6
    bool "ALIVE6"

config OOB_INTR_ALIVE_7
    bool "ALIVE7"

endchoice

choice
    prompt "H/W Event Features"
    default SECRET_1ST_BOARD

	config SECRET_1ST_BOARD
		bool "H/W 1st Board"
		help
   	 		SECRET H/W 1st Board.

	config SECRET_2ND_BOARD
		bool "H/W 2nd Board"
		help
   	 		SECRET H/W 2nd Board.

	config SECRET_2P1ND_BOARD
		bool "H/W 2.1 Board"
		help
   	 		SECRET H/W 2.1 Board.

	config SECRET_3RD_BOARD
		bool "H/W 3rd Board"
		help
   	 		SECRET H/W 3rd Board.
			
	config SECRET_3P1RD_BOARD
		bool "H/W 3.1 Board"
		help
   	 		SECRET H/W 3.1 Board.
endchoice
```

## drivers/media/dvb/dvb-soc/Kconfig
```kconfig
config NXP4330_MP2TS_IF
	tristate "NEXELL 4330 MP2TS driver"
	depends on I2C
	help
	  Support for MP2TS I/F based on the NEXELL NXP4330 chip.
```

## drivers/media/video/lf2000/Kconfig
```kconfig
#
# LF2000 V4L2 device drivers
#
menuconfig V4L2_LF2000
    tristate "LF2000 V4L2 Devices"
    depends on ARCH_CPU_NEXELL
    select VIDEOBUF_DMA_CONTIG
    select VIDEO_LF2000_DOUBLEBUF
    select VIDEO_LF2000_DEBUGFS
    select VIDEO_LF2000_SYSFS
    default n
    ---help---
      LF2000 compatible V4L2 device for VIP.

config VIDEO_LF2000_DEBUGFS
	bool "debugfs entries for LF2000 VIP"
	depends on V4L2_LF2000 && DEBUG_FS

config VIDEO_LF2000_SYSFS
	bool "sysfs entries for LF2000 VIP"
	depends on V4L2_LF2000 && SYSFS

if V4L2_LF2000

menuconfig SOC_CAMERA_HI253
    tristate "hi253 camera support"
    depends on V4L2_LF2000 && SOC_CAMERA && I2C
    select SOC_CAMERA_HYNIX_DEBUGFS
    select SOC_CAMERA_HYNIX_SYSFS
    default n
    ---help---
	  This is a V4L2 SoC camera driver for Hynix HI253 2MP sensors

config SOC_CAMERA_HYNIX_DEBUGFS
	bool "debugfs entries for Hynix YAC family sensors"
	depends on SOC_CAMERA_HI253 && DEBUG_FS

config SOC_CAMERA_HYNIX_SYSFS
	bool "sysfs entries for Hynix YAC family sensors"
	depends on SOC_CAMERA_HI253 && SYSFS

endif
```

## drivers/media/video/nexell/Kconfig
```kconfig
#
# Nexell NXP multimedia device drivers
#
menuconfig V4L2_NEXELL
    bool "Nexell V4L2 Devices"
    depends on ARCH_CPU_NEXELL
    select V4L2_MEM2MEM_DEV
    default n
    ---help---
      This is a representative nexell v4l2 device.

if V4L2_NEXELL

menuconfig VIDEO_NXP_CAPTURE
    bool "NXP Video capture interface"
    depends on V4L2_NEXELL
    default n
    ---help---
      Say Y here to enable NXP Video Capture Interface

if VIDEO_NXP_CAPTURE
source "drivers/media/video/nexell/capture/Kconfig"
endif

menuconfig VIDEO_NXP_M2M
    bool "NXP M2M interface"
    depends on V4L2_NEXELL
    default n
    ---help---
      Say y here to enable NXP M2M scaler or deinterlacer

if VIDEO_NXP_M2M
source "drivers/media/video/nexell/m2m/Kconfig"
endif

menuconfig VIDEO_NXP_OUT
    bool "NXP OUT interface"
    depends on V4L2_NEXELL
    default n
    ---help---
      Say y here to enable mlc, resolution converter, hdmi

if VIDEO_NXP_OUT
source "drivers/media/video/nexell/out/Kconfig"
endif

endif
```

## drivers/media/video/nexell/capture/Kconfig
```kconfig
if VIDEO_NXP_CAPTURE

config NXP_CAPTURE_DECIMATOR
    bool "Enable capture decimator"
    default n
    ---help---
      Say y here to enable decimator

config NXP_CAPTURE_MIPI_CSI
    bool "Enable capture mipi csi interface"
    default n
    ---help---
      Say y here to enable capture mipi csi interface

endif
```

## drivers/media/video/nexell/out/Kconfig
```kconfig
if VIDEO_NXP_OUT

config NXP_OUT_RESOLUTION_CONVERTER
    bool "Enable out resolution converter"
	select NEXELL_DISPLAY_RESCONV
    default n
    ---help---
      Say y here to enable v4l2 resolution converter

config NXP_OUT_HDMI
    bool "Enable out HDMI"
    default n
    ---help---
      Say y here to enable v4l2 hdmi

if NXP_OUT_HDMI
source arch/arm/mach-nxp4330/soc/hdmi/Kconfig
endif

config NXP_HDMI_CEC
    depends on NXP_OUT_HDMI || NEXELL_DISPLAY_HDMI
    bool "Enable HDMI CEC Misc Driver"
    default n
    ---help---
      Say y here to enable hdmi cec module

endif
```

## drivers/video/nexell/Kconfig
```kconfig
#
# Video configuration
#

menu "Nexell Graphics"
	depends on HAS_IOMEM

config FB_NEXELL_ION_MEM
	bool "Allocate framebuffer with ION "
	depends on FB_NEXELL
	select ION
	select ION_NXP
	default n

config FB0_NEXELL
	bool "Support primary   frame buffer (/dev/fb0)"
	depends on FB_NEXELL
	default y

	config FB0_NEXELL_DISPOUT
		int "Display Out [0/1]"
		depends on FB0_NEXELL
		default 0

config FB1_NEXELL
	bool "Support secondary frame buffer (/dev/fb1)"
	depends on FB_NEXELL
	default n

	config FB1_NEXELL_DISPOUT
		int "Display Out [0/1]"
		depends on FB1_NEXELL
		default 1

config NEXELL_DISPLAY_LCD
	bool "LCD"
	default n

	config NEXELL_DISPLAY_LCD_IN
		int "Display In  [0=Display 0, 1=Display 1]"
		depends on NEXELL_DISPLAY_LCD
		default 0

config NEXELL_DISPLAY_LVDS
	bool "LVDS"
	default n

	config NEXELL_DISPLAY_LVDS_IN
		int "Display In  [0=Display 0, 1=Display 1]"
		depends on NEXELL_DISPLAY_LVDS
		default 0

config NEXELL_DISPLAY_MIPI
	bool "MIPI"

	config NEXELL_DISPLAY_MIPI_IN
		int "Display In  [0=Display 0, 1=Display 1]"
		depends on NEXELL_DISPLAY_MIPI
		default 0

config NEXELL_DISPLAY_HDMI
	bool "HDMI"

	config NEXELL_DISPLAY_HDMI_IN
		int "Display In  [0=Display 0, 1=Display 1]"
		depends on NEXELL_DISPLAY_HDMI
		default 0

	choice
		prompt "Resolution"
		depends on NEXELL_DISPLAY_HDMI
		default NEXELL_DISPLAY_HDMI_1280_720P

	config	NEXELL_DISPLAY_HDMI_1280_720P
		bool "1280 *  720p"

	config	NEXELL_DISPLAY_HDMI_1920_1080P
		bool "1920 * 1080p"

	endchoice

    choice
        prompt "HDMI Audio Interface"
        depends on NXP_OUT_HDMI || NEXELL_DISPLAY_HDMI
        default NEXELL_DISPLAY_HDMI_AUDIO_SPDIF
        help
          Choose which interface to use for hdmi audio output

    config NEXELL_DISPLAY_HDMI_AUDIO_SPDIF
        bool "SPDIF"

    config NEXELL_DISPLAY_HDMI_AUDIO_I2S
        bool "I2S"

    endchoice

config NEXELL_DISPLAY_HDMI_USE_HDCP
    depends on NEXELL_DISPLAY_HDMI
    bool "HDMI use HDCP block"
    default n
    ---help---
      Say y here to enable hdcp module

endmenu
```

## drivers/video/nexell/Kconfig.resc
```kconfig
#
# Video configuration
#

menu "Graphics support"
	depends on HAS_IOMEM

config FB_NEXELL_ION_MEM
	bool "Allocate framebuffer with ION "
	depends on FB_NEXELL
	select ION
	select ION_NXP
	default n

config FB0_NEXELL
	bool "Support primary   frame buffer (/dev/fb0)"
	depends on FB_NEXELL
	select NEXELL_DISPLAY
	select NEXELL_DISPLAY_1ST
	default y

	config FB0_NEXELL_DISPOUT
		int "Display Out [0/1]"
		depends on FB0_NEXELL
		default 0

config FB1_NEXELL
	bool "Support secondary frame buffer (/dev/fb1)"
	depends on FB_NEXELL
	select NEXELL_DISPLAY
	select NEXELL_DISPLAY_2ST
	default n

	config FB1_NEXELL_DISPOUT
		int "Display Out [0/1]"
		depends on FB1_NEXELL
		default 1

config NEXELL_DISPLAY_LCD
	bool "LCD"
	default n

	config NEXELL_DISPLAY_LCD_IN
		int "Display In  [0=Display 0, 1=Display 1, 2=Resolution Convertor]"
		depends on NEXELL_DISPLAY_LCD
		default 0

config NEXELL_DISPLAY_LVDS
	bool "LVDS"
	default n

	config NEXELL_DISPLAY_LVDS_IN
		int "Display In  [0=Display 0, 1=Display 1, 2=Resolution Convertor]"
		depends on NEXELL_DISPLAY_LVDS
		default 0

config NEXELL_DISPLAY_MIPI
	bool "MIPI"

	config NEXELL_DISPLAY_MIPI_IN
		int "Display In  [0=Display 0, 1=Display 1, 2=Resolution Convertor]"
		depends on NEXELL_DISPLAY_MIPI
		default 0

config NEXELL_DISPLAY_HDMI
	bool "HDMI"

	config NEXELL_DISPLAY_HDMI_IN
		int "Display In  [0=Display 0, 1=Display 1, 2=Resolution Convertor]"
		depends on NEXELL_DISPLAY_HDMI
		default 0

	choice
		prompt "Resolution"
		depends on NEXELL_DISPLAY_HDMI
		default NEXELL_DISPLAY_HDMI_1280_720P

	config	NEXELL_DISPLAY_HDMI_1280_720P
		bool "1280 *  720p"

	config	NEXELL_DISPLAY_HDMI_1920_1080P
		bool "1920 * 1080p"

	endchoice

config NEXELL_DISPLAY_RESC
	bool "RESOLUTION CONVERTOR"
	default n

	config NEXELL_DISPLAY_RESC_IN
		int "Display In  [0=Display 0, 1=Display 1]"
		depends on NEXELL_DISPLAY_RESC
		default 0

endmenu
```
